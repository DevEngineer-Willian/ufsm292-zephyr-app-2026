## lib/radio/Kconfig
```kconfig
# Copyright (c) 2026
# SPDX-License-Identifier: Apache-2.0

config RADIO
	bool "Shared 802.15.4 sensor-frame codec"
	help
	  Enables the shared 802.15.4 sensor-frame encoder/decoder. The on-air
	  format is an 18-byte payload carried in a standard MAC data frame.
```
